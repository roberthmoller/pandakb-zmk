## boards/shields/app_layer/Kconfig.defconfig
```kconfig
if SHIELD_APP_LAYER

config PANDAKB_APP_LAYER
	default y

config PANDAKB_APP_LAYER_RAW_HID
	default y if RAW_HID

endif # SHIELD_APP_LAYER
```

## boards/shields/bare_right/Kconfig.defconfig
```kconfig
if SHIELD_BARE_RIGHT

config ZMK_DISPLAY
	default n

config ZMK_RGB_UNDERGLOW
	default n

endif # SHIELD_BARE_RIGHT
```

## boards/shields/game_badge/Kconfig.defconfig
```kconfig
if SHIELD_GAME_BADGE

config PANDAKB_APP_LAYER
	default y

config PANDAKB_GAME_BADGE_SCREEN
	default y

config ZMK_DISPLAY
	default y

choice ZMK_DISPLAY_STATUS_SCREEN
	default ZMK_DISPLAY_STATUS_SCREEN_CUSTOM
endchoice

choice ZMK_DISPLAY_WORK_QUEUE
	default ZMK_DISPLAY_WORK_QUEUE_DEDICATED
endchoice

endif # SHIELD_GAME_BADGE
```

## boards/shields/row_swap_diag/Kconfig.shield
```kconfig
# Copyright (c) 2026
# SPDX-License-Identifier: MIT

config SHIELD_ROW_SWAP_DIAG
	def_bool $(shields_list_contains,row_swap_diag)
```

## modules/app-layer/Kconfig
```kconfig
menuconfig PANDAKB_APP_LAYER
	bool "PandaKB app companion (Raw HID media status)"
	default n
	help
	  Accept host Raw HID commands to push media play/pause and
	  volume to the peripheral OLED.

if PANDAKB_APP_LAYER

config PANDAKB_APP_LAYER_RAW_HID
	bool "Handle Raw HID media commands"
	default y
	depends on RAW_HID
	help
	  Listen for Raw HID reports on the central and apply set_media.

config PANDAKB_GAME_BADGE_SCREEN
	bool "Custom status screen: media + battery"
	default n
	depends on ZMK_DISPLAY
	select LV_USE_LABEL
	select LV_USE_CANVAS
	select LV_FONT_MONTSERRAT_12
	help
	  Right OLED (portrait, -90° mount): battery + link at top,
	  play/pause and volume below. Enable via the game_badge shield;
	  do not select choice symbols here.

endif # PANDAKB_APP_LAYER
```

## modules/app-layer/dts/bindings/behaviors/zmk,behavior-game-badge.yaml
```yaml
# Copyright (c) 2026 PandaKB
# SPDX-License-Identifier: MIT

description: Set the PandaKB media play/volume status (global locality for split sync)

compatible: "zmk,behavior-game-badge"

include: two_param.yaml
```

## modules/app-layer/dts/bindings/behaviors/zmk,behavior-mo-preview.yaml
```yaml
# Copyright (c) 2026 PandaKB
# SPDX-License-Identifier: MIT

description: >
  Momentary layer with optional companion layout preview on double-tap-hold.
  Behaves like &mo; a second press within the tap window also notifies the host
  over Raw HID (0x20 LAYER_PREVIEW) while held.

compatible: "zmk,behavior-mo-preview"

include: one_param.yaml
```
