/*
 * Copyright (c) 2026 PandaKB
 * SPDX-License-Identifier: MIT
 */

/ {
    behaviors {
        badge: badge {
            compatible = "zmk,behavior-game-badge";
            #binding-cells = <2>;
            display-name = "Widget Status";
        };
    };
};
